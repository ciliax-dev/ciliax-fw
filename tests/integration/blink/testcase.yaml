## tests/integration/blink/testcase.yaml
```yaml
tests:
  blink.smoke:
    platform_allow: native_sim
    harness: ztest
    tags: integration
```

## tests/integration/event_flow/testcase.yaml
```yaml
tests:
  app.event_flow:
    platform_allow:
      - native_sim
    harness: ztest
    tags: integration
```

## tests/integration/zephyr_status_indicator/testcase.yaml
```yaml
tests:
  app.zephyr_status_indicator:
    platform_allow:
      - native_sim
    harness: ztest
    tags: integration
```

## west.yml
```yaml
manifest:
  version: "1.2"

  remotes:
    - name: ncs
      url-base: https://github.com/nrfconnect
    - name: etlcpp
      url-base: https://github.com/ETLCPP

  projects:
    - name: nrf
      remote: ncs
      repo-path: sdk-nrf
      revision: v3.2.4
      import:
        name-allowlist:
          - zephyr
          - mcuboot
          - mbedtls
          - cmsis
          - cmsis_6
          - hal_nordic
          - nrfxlib
          - segger
          - tinycrypt
    - name: etl
      remote: etlcpp
      revision: 20.47.1
      path: modules/lib/etl

  self:
    path: ciliax-fw
```
