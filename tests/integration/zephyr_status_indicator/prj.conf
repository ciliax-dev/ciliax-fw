## CMakeLists.txt
```
cmake_minimum_required(VERSION 3.20.0)

find_package(Zephyr REQUIRED HINTS $ENV{ZEPHYR_BASE})

project(zephyr_status_indicator LANGUAGES C CXX)

set(APP_SRC ${CMAKE_SOURCE_DIR}/../../../app/src)

# Pulls the production ZephyrStatusIndicator into a native_sim ztest
# so its set_pattern() mapping and k_work_delayable blink driver can
# be asserted against gpio_emul. led0 is provided by native_sim's
# default DT (gpio_emul-backed); no overlay needed.
target_sources(app PRIVATE
    src/main.c
    src/status_indicator_init.cpp
    ${APP_SRC}/adapters/zephyr/zephyr_status_indicator.cpp
)

target_include_directories(app PRIVATE ${APP_SRC})

list(APPEND CMAKE_MODULE_PATH ${CMAKE_CURRENT_LIST_DIR}/../../../cmake)
include(zephyr_cxx_includes)
ciliax_add_cxx_includes(app)
```

## prj.conf
```kconfig
CONFIG_ZTEST=y
CONFIG_LOG=y
CONFIG_GPIO=y
CONFIG_CPP=y
CONFIG_STD_CPP20=y
```

## src/main.c
```c
#include <zephyr/kernel.h>
#include <zephyr/ztest.h>

extern void set_off(void);
extern void set_fast_blink(void);
extern void set_solid_on(void);
extern int read_pin(void);

ZTEST_SUITE(zephyr_status_indicator, NULL, NULL, NULL, NULL, NULL);

ZTEST(zephyr_status_indicator, test_solid_on_drives_pin_high) {
    set_off();
    set_solid_on();
    zassert_equal(read_pin(), 1);
    set_off();
}

ZTEST(zephyr_status_indicator, test_off_drives_pin_low) {
    set_solid_on();
    set_off();
    zassert_equal(read_pin(), 0);
}

ZTEST(zephyr_status_indicator, test_fast_blink_toggles_pin) {
    set_off();
    int before = read_pin();
    set_fast_blink();
    /* 100 ms half-period; 150 ms guarantees at least one toggle has fired. */
    k_msleep(150);
    int after = read_pin();
    zassert_not_equal(before, after);
    set_off();
}
```

## src/status_indicator_init.cpp
```c
#include <zephyr/devicetree.h>
#include <zephyr/drivers/gpio.h>
#include <zephyr/drivers/gpio/gpio_emul.h>

#include "adapters/zephyr/zephyr_status_indicator.hpp"

namespace {
const struct gpio_dt_spec kLedSpec = GPIO_DT_SPEC_GET(DT_ALIAS(led0), gpios);
ZephyrStatusIndicator g_status{kLedSpec};
} // namespace

extern "C" void set_off(void) {
    g_status.set_pattern(StatusPattern::Off);
}

extern "C" void set_fast_blink(void) {
    g_status.set_pattern(StatusPattern::FastBlink);
}

extern "C" void set_solid_on(void) {
    g_status.set_pattern(StatusPattern::SolidOn);
}

extern "C" int read_pin(void) {
    return gpio_emul_output_get(kLedSpec.port, kLedSpec.pin);
}
```
